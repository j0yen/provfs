## lsm/Kconfig
```kconfig
config SECURITY_PROVFS
	bool "provfs: stamp user.prov.* xattrs on writes"
	depends on SECURITY
	default n
	help
	  provfs is a small, stackable Linux Security Module that stamps
	  user.prov.session and user.prov.ts xattrs on every file
	  successfully closed after being opened for write.

	  When the writer is inside an agent namespace the session value is
	  the 32-hex AgentNS session id. Otherwise an enriched fallback is
	  stamped: "comm-chain:<c0>>..;env:<KEY>=<val>;cwd:<path>;pid:<p>;
	  uid:<u>" — the parent comm chain (up to 3 levels), the first of
	  $CLAUDE_TOOL/$AGORABUS_SID/$CLAUDE_SESSION_ID found in the writer's
	  env, and the writer's cwd. The value is capped at 256 bytes;
	  truncation drops fields from the right so the outermost actor is
	  preserved.

	  Files under /proc, /sys, /dev, /run, /tmp, .git, node_modules,
	  target, and the cargo registry are skipped.

	  Pairs with the userspace FUSE-overlay provfs daemon (which
	  handles filesystems that don't support user xattrs natively)
	  and a userspace `prov` CLI for reading the xattrs.

	  The xattr writes are deferred to a bounded workqueue so the
	  file_release hook stays off the journaled-write hot path; tune
	  the in-flight bound via /proc/sys/kernel/provfs/queue_max and
	  observe drops via .../queue_dropped.

	  See Documentation/admin-guide/LSM/provfs.rst.

	  If unsure, say N.
```
